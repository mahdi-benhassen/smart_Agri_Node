## field_node/sdkconfig.defaults
```kconfig
# ═══════════════════════════════════════════════════════════════════
# sdkconfig.defaults — SAGRI Smart Agriculture IoT System
# Default Kconfig settings for both Gateway (ESP32-S3) and Node (ESP32-H2)
# ═══════════════════════════════════════════════════════════════════

# ── Core ──────────────────────────────────────────────────────────
CONFIG_IDF_TARGET="esp32s3"
CONFIG_ESPTOOLPY_FLASHSIZE_8MB=y
CONFIG_PARTITION_TABLE_CUSTOM=y
CONFIG_PARTITION_TABLE_CUSTOM_FILENAME="partitions.csv"

# ── OTA ───────────────────────────────────────────────────────────
CONFIG_BOOTLOADER_APP_ROLLBACK_ENABLE=y
CONFIG_BOOTLOADER_APP_ANTI_ROLLBACK=y

# ── Security ─────────────────────────────────────────────────────
CONFIG_SECURE_BOOT=y
CONFIG_SECURE_BOOT_V2_ENABLED=y
CONFIG_SECURE_FLASH_ENC_ENABLED=y
CONFIG_MBEDTLS_TLS_CLIENT=y
CONFIG_MBEDTLS_TLS_SERVER=y

# ── Wi-Fi ─────────────────────────────────────────────────────────
CONFIG_ESP_WIFI_STATIC_RX_BUFFER_NUM=16
CONFIG_ESP_WIFI_DYNAMIC_TX_BUFFER_NUM=32

# ── MQTT ──────────────────────────────────────────────────────────
CONFIG_MQTT_TRANSPORT_SSL=y
CONFIG_MQTT_BUFFER_SIZE=4096

# ── Logging (production) ─────────────────────────────────────────
CONFIG_LOG_DEFAULT_LEVEL_INFO=y
CONFIG_LOG_TIMESTAMP_SOURCE_RTOS=y

# ── FreeRTOS ──────────────────────────────────────────────────────
CONFIG_FREERTOS_HZ=1000
CONFIG_FREERTOS_ENABLE_BACKWARD_COMPATIBILITY=n
CONFIG_ESP_TASK_WDT=y
CONFIG_ESP_TASK_WDT_TIMEOUT_S=30

# ── SPIFFS ────────────────────────────────────────────────────────
CONFIG_SPIFFS_USE_MAGIC=y
CONFIG_SPIFFS_USE_MAGIC_LENGTH=y

# ── C Standard ────────────────────────────────────────────────────
CONFIG_COMPILER_CXX_EXCEPTIONS=n
```
